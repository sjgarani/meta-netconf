## conf/layer.conf
```bitbake
# We have a conf and classes directory, add to BBPATH
BBPATH .= ":${LAYERDIR}"

# We have recipes-* directories, add to BBFILES
BBFILES += "${LAYERDIR}/recipes-*/*/*.bb \
            ${LAYERDIR}/recipes-*/*/*.bbappend"

BBFILE_COLLECTIONS += "meta-netconf"
BBFILE_PATTERN_meta-netconf = "^${LAYERDIR}/"
BBFILE_PRIORITY_meta-netconf = "6"

LAYERDEPENDS_meta-netconf = "core"
LAYERSERIES_COMPAT_meta-netconf = "dunfell"
```
